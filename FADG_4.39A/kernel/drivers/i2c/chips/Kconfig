## FADG_4.39A/kernel/drivers/i2c/chips/Kconfig
```kconfig
#
# Miscellaneous I2C chip drivers configuration
#
# *** DEPRECATED! Do not add new entries! See Makefile ***
#

menu "Miscellaneous I2C Chip support"

	
config SENSORS_MT9T013
	tristate "MT9T013 Camera Driver"
	depends on I2C
	default y
	help
	 MT9T013 Camera Driver implemented by HTC.

# +++ FIH_FXX +++  // Square 20110502
config SC668
	tristate "SC668 light management with LDOs"
	depends on I2C=y && ARCH_MSM
	help
# --- FIH_FXX ---
config BACKLIGHT_LED_TPS61160
	tristate "TPS61160 backlight controller"
	help
		TPS61160 backlight IC

config BACKLIGHT_LED_RT9365
	tristate "RT9365 backlight controller"
	help
		RT9365 backlight IC
config VP_A1026
	tristate "A1026 Voice Processor Driver"
	depends on I2C
	help
	  A1026 Voice Processor Driver implemented by HTC.

config FLASH_DRIVER_IC_AAT1272
	tristate "aat1272 flash led driver"
	depends on I2C=y && ARCH_MSM
	help

endmenu
```
